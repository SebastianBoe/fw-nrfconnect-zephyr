## prj.conf
```kconfig
CONFIG_TFM_PROFILE_TYPE_NOT_SET=y
CONFIG_TFM_SPM_LOG_LEVEL_DEBUG=y
CONFIG_TFM_EXCEPTION_INFO_DUMP=y
CONFIG_TFM_PARTITION_LOG_LEVEL_DEBUG=y

CONFIG_PPI_TRACE=y

CONFIG_REBOOT=n
CONFIG_PRINTK=y
CONFIG_RESET_ON_FATAL_ERROR=n
CONFIG_HW_STACK_PROTECTION=y
CONFIG_RUNTIME_ERROR_CHECKS=y
CONFIG_FAULT_DUMP=2
```

## src/main.c
```c
/*
 * Copyright (c) 2021 Nordic Semiconductor ASA.
 *
 * SPDX-License-Identifier: Apache-2.0
 */

#include <zephyr/kernel.h>
#include <tfm_veneers.h>
#include <tfm_ns_interface.h>

#include <hal/nrf_rtc.h>

#include "dummy_partition.h"

#define TIMER_PIN 10
#define DEBUG_PIN 11

static void my_timer_handler(struct k_timer *dummy)
{
}

static K_TIMER_DEFINE(my_timer, my_timer_handler, NULL);

static void conf(uint32_t pin, uint32_t evt)
{
	void *handle;

	handle = ppi_trace_config(pin, evt);
	__ASSERT(handle != NULL,
		"Failed to initialize trace pin, no PPI or GPIOTE resources?");

	ppi_trace_enable(handle);
}

void trace_enable(void) {
	conf(TIMER_PIN,
		 nrf_rtc_event_address_get(NRF_RTC1_NS, NRF_RTC_EVENT_COMPARE_0));

	NRF_P0->DIRSET |= 1 << DEBUG_PIN;

	NRF_P0->OUTSET |= 1 << DEBUG_PIN;
	for(volatile int i = 0; i < 1000; i++);
	NRF_P0->OUTCLR |= 1 << DEBUG_PIN;
}

void main(void)
{
	uint8_t digest[32];

	trace_enable();

    k_timer_start(&my_timer, K_USEC(100), K_USEC(300));

	for (int key = 0; key < 6; key++) {
		psa_status_t status = dp_secret_digest(key, digest, sizeof(digest));

		if (status == PSA_ERROR_INVALID_ARGUMENT && key == 5) {
			printk("No valid secret for key, received expected error code\n");
		} else if (status != PSA_SUCCESS) {
			printk("Status: %d\n", status);
		} else {
			printk("Digest: ");
			for (int i = 0; i < 32; i++) {
				printk("%02x", digest[i]);
			}
			printk("\n");
		}
	}
}
```
