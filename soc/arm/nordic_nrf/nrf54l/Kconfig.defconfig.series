## soc/arm/nordic_nrf/nrf54l/Kconfig.defconfig.series
```kconfig
# Nordic Semiconductor nRF54L MCU line

# Copyright (c) 2024 Nordic Semiconductor ASA
# SPDX-License-Identifier: Apache-2.0

if SOC_SERIES_NRF54LX

rsource "Kconfig.defconfig.nrf54l*"

config SOC_SERIES
	default "nrf54l"

config CORTEX_M_SYSTICK
	default !NRF_GRTC_TIMER

config CACHE_NRF_CACHE
	default y if EXTERNAL_CACHE

config SOC_NRF54LX_DISABLE_FICR_TRIMCNF
	bool "Skip clock frequency configuration in system initialization"
	default y if TRUSTED_EXECUTION_NONSECURE
	help
	  Disable trimming of the device. When the device is trimmed it
	  will copy all the trimming values from FICR into the target
	  addresses. When TF-M is enabled it will trim the device before
	  booting this image.

endif # SOC_SERIES_NRF54LX
```
